## central_kbds/build/Kconfig/Kconfig.shield
```kconfig
osource "c:/nordic/myApps/peripheral_lbs_unmodified/boards/shields/*/Kconfig.shield"
osource "c:/nordic/myApps/peripheral_kbds/boards/shields/*/Kconfig.shield"
osource "C:/nordicsemi/v2.1.2/nrf/boards/shields/*/Kconfig.shield"
```

## peripheral_hids_keyboard/build_1/Kconfig/Kconfig.shield.defconfig
```kconfig
osource "c:/nordic/myApps/peripheral_lbs_unmodified/boards/shields/*/Kconfig.defconfig"
osource "c:/nordic/myApps/peripheral_kbds/boards/shields/*/Kconfig.defconfig"
osource "C:/nordicsemi/v2.1.2/nrf/boards/shields/*/Kconfig.defconfig"
```
